## config/west.yml
```yaml
manifest:
  remotes:
    - name: zmkfirmware
      url-base: https://github.com/zmkfirmware
    - name: sayu-hub
      url-base: https://github.com/sayu-hub

  projects:
    - name: zmk
      remote: zmkfirmware
      revision: main
      import: app/west.yml

 remotes:
  - name: sho-pmw
    url-base: https://github.com/Onigiri048

projects:
  - name: zmk-pmw3610-driver-
    remote: sho-pmw
    revision: main
      path: zmk-pmw3610-driver-

  self:
    path: config
```
